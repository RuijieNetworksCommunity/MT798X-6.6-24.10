
/dts-v1/;
#include "mt7988d-ruijie-rg-be72-pro-base.dtsi"

/ {
	model = "Ruijie BE72 PRO";
	compatible = "ruijie,rg-be72-pro", "mediatek,mt7988d";
};

&partitions {
	partition@780000 {
		label = "ubi";
		reg = <0x780000 0x7080000>;
	};
};